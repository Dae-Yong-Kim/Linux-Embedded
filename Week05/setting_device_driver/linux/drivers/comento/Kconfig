## Week05/setting_device_driver/linux/drivers/comento/Kconfig
```kconfig
menu "Comento Example Driver"

config COMENTO_EXAMPLE
	tristate "Comento Example Driver"
	help
		This is an example driver using comento class.

endmenu
```
